## yocto_image/poky-scarthgap-5.0/poky/rpi4/conf/bblayers.conf
```bitbake
# POKY_BBLAYERS_CONF_VERSION is increased each time build/conf/bblayers.conf
# changes incompatibly
POKY_BBLAYERS_CONF_VERSION = "2"

BBPATH = "${TOPDIR}"
BBFILES ?= ""

BBLAYERS ?= " \
  /home/esteban/githubclone/RemoteCar-Embedded/yocto_image/poky-scarthgap-5.0/poky/meta \
  /home/esteban/githubclone/RemoteCar-Embedded/yocto_image/poky-scarthgap-5.0/poky/meta-poky \
  /home/esteban/githubclone/RemoteCar-Embedded/yocto_image/poky-scarthgap-5.0/poky/meta-yocto-bsp \
  /home/esteban/githubclone/RemoteCar-Embedded/yocto_image/poky-scarthgap-5.0/poky/meta-openembedded/meta-oe \
  /home/esteban/githubclone/RemoteCar-Embedded/yocto_image/poky-scarthgap-5.0/poky/meta-openembedded/meta-networking \
  /home/esteban/githubclone/RemoteCar-Embedded/yocto_image/poky-scarthgap-5.0/poky/meta-openembedded/meta-multimedia \
  /home/esteban/githubclone/RemoteCar-Embedded/yocto_image/poky-scarthgap-5.0/poky/meta-raspberrypi \
  /home/esteban/githubclone/RemoteCar-Embedded/yocto_image/poky-scarthgap-5.0/poky/meta-projectconfig \
"
```
